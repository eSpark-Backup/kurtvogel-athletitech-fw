## CMakeLists.txt
```
cmake_minimum_required(VERSION 3.20.0)


# Append UBXLIB as a Zephyr module
get_filename_component(UBXLIB_BASE ${CMAKE_CURRENT_LIST_DIR}/components/GNSS/ubxlib  ABSOLUTE)


# Add ubxlib as a module
list(APPEND ZEPHYR_EXTRA_MODULES ${UBXLIB_BASE})

find_package(Zephyr REQUIRED HINTS $ENV{ZEPHYR_BASE})

project(App)

target_sources(app PRIVATE src/main.cpp)

# External Modules
add_subdirectory(components/BLE)
add_subdirectory(components/IMU)
add_subdirectory(components/GNSS)
add_subdirectory(components/Magnetometer)
```

## prj.conf
```kconfig
CONFIG_LOG=y
# # CONFIG_LOG_MODE_DEFERRED=y       # More efficient mode (logs are deferred until the thread is not running)
# # CONFIG_LOG_DEFAULT_LEVEL=4       

CONFIG_I2C=y
CONFIG_SENSOR=y
CONFIG_STATIC_INIT_GNU=y


CONFIG_BT=y
CONFIG_BT_PERIPHERAL=y
CONFIG_BT_DEVICE_NAME="Athletitech_BLE"

# prj.conf
#
# This file is used when testing inclusion of ubxlib as
# a Zephyr module by setting the CMake variable
# ZEPHYR_EXTRA_MODULES to the root directory of ubxlib.
#
# These are the *absolute* *minimum* set of CONFIG values
# required by ubxlib.

# Always needed

CONFIG_GNSS=y
CONFIG_UBXLIB=y

# When using the Zephyr minimal libc we don't want to use the libc
# memory management since it does not use k_malloc, resulting in
# two heaps which might waste a lot of memory. Therefore we map
# malloc/free directly to k_malloc/k_free and disable libc RAM
# with CONFIG_MINIMAL_LIBC_MALLOC=n.
# If newlib is being used this will be ignored.
# CONFIG_MINIMAL_LIBC_MALLOC=n

# ubxlib does not need anything like this much heap, this is simply
# a suggestion for your application, feel free to override it.
CONFIG_HEAP_MEM_POOL_SIZE=131072

# Required for uPortTaskStackMinFree() to work
CONFIG_INIT_STACKS=y
CONFIG_THREAD_STACK_INFO=y
CONFIG_THREAD_NAME=y

# You will need additional configuration variables depending
# on the features of ubxlib/Zephyr required.
#
# See port/platform/zephyr/default.conf for the recommended set,
# so slightly more than this file, that are brought in automatically
# if you bring ubxlib into your CMakeLists.txt file with the line
#
# include($ENV{UBXLIB_DIR}/zephyr/ubxlib.cmake)
#
# ...rather than using ZEPHYR_EXTRA_MODULES.
#
# See port/platform/zephyr/runner/prj.conf and/or
# port/platform/zephyr/runner_linux/prj.conf for the detailed
# set of items, needed to select I2C, SPI, various BLE things,
# etc., which we employ when testing.
```

## src/main.cpp
```c
#include <zephyr/kernel.h>
#include <zephyr/logging/log.h>

#include "Magnetometer.hpp"
#include "BLEManager.hpp"
#include "GNSS.hpp"
#include "IMU.hpp"

#define MAIN_TASK_STACK_SIZE 4096
#define MAIN_TASK_PRIORITY 1

#define GNSS_TASK_STACK_SIZE 1024
#define GNSS_TASK_PRIORITY 2

LOG_MODULE_REGISTER(Main, LOG_LEVEL_DBG);  // LOG_LEVEL_DBG shows everything


K_THREAD_STACK_DEFINE(mainStackkSize, MAIN_TASK_STACK_SIZE);
struct k_thread mainTaskThreadState;

K_THREAD_STACK_DEFINE(gnssStackSize, GNSS_TASK_STACK_SIZE);
struct k_thread gnssTaskThreadState;

Magnetometer magneto;
BLEManager ble;
IMU iMU;
Gnss gps;



void mainTask(void *arg1, void *arg2, void *arg3) {
        while (1) {                        
                ble.loop();
                magneto.loop();
                iMU.loop();

                k_msleep(1000);                        
        }
}

void gnssTask(void *arg1, void *arg2, void *arg3){

        gps.loop();
}


int main(void)
{
        ble.init();
        magneto.init();
        iMU.init();
        gps.init();

 

        k_thread_create(&mainTaskThreadState, mainStackkSize,
                MAIN_TASK_STACK_SIZE, mainTask,
                NULL, NULL, NULL,
                MAIN_TASK_PRIORITY, 0, K_NO_WAIT);

        
        k_thread_create(&gnssTaskThreadState, gnssStackSize,
                        GNSS_TASK_STACK_SIZE, gnssTask,
                        NULL, NULL, NULL,
                        GNSS_TASK_PRIORITY, 0, K_NO_WAIT);

}
```
