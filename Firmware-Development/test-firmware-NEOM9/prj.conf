## CMakeLists.txt
```
cmake_minimum_required(VERSION 3.20.0)
find_package(Zephyr REQUIRED HINTS $ENV{ZEPHYR_BASE})

project(Application)

target_sources(app PRIVATE src/main.c)

# External Modules
list(APPEND ZEPHYR_EXTRA_MODULES ${CMAKE_CURRENT_SOURCE_DIR}/components/ubxlib)
```

## west.yml
```
manifest:
  version: "1.2"

  remotes:
    - name: u-blox
      url-base: https://github.com/u-blox

  projects:
    - name: ubxlib
      remote: u-blox
      path: ubxlib
      import: true
      clone-depth: 1

  self:
    path: test-firmware-NEOM9N
```

## prj.conf
```kconfig
CONFIG_I2C=y
CONFIG_LOG=y
CONFIG_UBXLIB=y
```

## src/main.c
```c
#include "ubxlib.h"
#include "zephyr/kernel.h"
#include "zephyr/device.h"
#include "zephyr/devicetree.h"
#include "zephyr/drivers/i2c.h"



void main(void) {


        
}
```
